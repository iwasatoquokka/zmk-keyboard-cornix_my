## config/boards/arm/cornix/Kconfig.defconfig
```kconfig
if BOARD_CORNIX_LEFT || BOARD_CORNIX_RIGHT

config ZMK_SPLIT_ROLE_CENTRAL
    bool
    default n
    override

config BT_CENTRAL
    bool
    default n
    override

endif
```

## config/boards/shields/cornix/cornix_left.defconfig
```kconfig
# 基本のボード設定を継承（外部リポジトリのやつ）
CONFIG_ZMK_KEYBOARD_NAME="Cornix"

# 外部リポジトリが強制してくる CENTRAL=y を力技で上書き！
CONFIG_ZMK_SPLIT_ROLE_CENTRAL=n
CONFIG_BT_CENTRAL=n

# 子機として必要な設定
CONFIG_ZMK_SPLIT=y
CONFIG_ZMK_SPLIT_BLE=y
CONFIG_BT_PERIPHERAL=y
```
